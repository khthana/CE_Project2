/*
Module : PING.CPP
Purpose: Implementation for an MFC wrapper class to encapsulate PING
Created: PJN / 10-06-1998
History: PJN / 23-06-1198 1) Now code can be compiled to use Winsock2 calls
                          instead of using the ICMP.DLL. This gives another of
                          advantages:

                          i)  Your using a API that MS has promised to continue to support.
                          ii) Internally the class calls QueryPerformanceCounter meaning that
                              you will get the highest resolution RTT's possible.

                          2) Also did a general tidy up of the code
                          3) Changed default timeout to 1 second
         PJN / 30-07-1998 1) Can now use both Winsock 2 calls and ICMP style
				                     calls at the same time with the use of 2 preprocessor directives
                          2) sample program now use generic entry point _tmain 
													3) Got rid of a 2 level 4 compiler warning
													4) Fixed a problem with the cleanup of ICMP dll usage
													5) Tidied up and optimized the usage of static variables
         PJN / 01-03-2000 1) Fixed a problem where I was incorrectly overwritting memory in          
                             the function FillIcmpData  
         PJN / 15-07-2001 1) Updated copyright information
                          2) Code now automatically pulls in the Winsock 2 libraries as and when needed
         PJN / 12-01-2002 1) Updated copyright information
                          2) Now initializes Winsock 2.0 instead of Winsock 2.1. Thanks to Lev Elbert
                          for spotting this problem.
         PJN / 24-02-2002 1) Winsock 2 code path now allows you to bind the socket to a specific NIC.
                          This can prove useful when you want to run a targeted ping request on a
                          mulithoned machine.
                          2) Tidied up the code in the sample application
                          3) Provide a complete set of command line options for the sample app. It
                          now provides almost a 1 - 1 implementation of the build in Ping options.
                          4) Completed reworked and recoded all the CPing code.
                          5) Client code is now responsible for initializing Winsock instead of 
                          having it embedded in the CPing code
         PJN / 05-05-2002 1) Now includes a EchoReplyStatus in CPingReply structure if CPING_NO_ICMP is not 
                          defined
         PJN / 21-11-2002 1. Fixed an issue in the calculation of the packet size when sending using 
                          raw sockets.
                          2. Default sample now uses a default TTL of 30
                          3. Changes the nPacketSize parameter to the Ping method to be nDataSize which is 
                          what it really is.
                          4. Reviewed all the TRACE messages for correctness
                          5. Made all the helper functions used by the code member functions of the class
                          6. General tidy up of the various defines
                          7. Winsock 2 version of ping now allows you to specify the sequence number of the 
                          packet. This allows the ping to exclude packets from the same process id which
                          are being generated by for example another thread.
                          8. Fixed a bug in the call to recvfrom. The receive buffer size was not being
                          specified correctly.
                          9. ICMP response packets from other processes are now ignored when waiting for 
                          an ICMP response
                          10. ICMP response packets from the same process but which have an incorrect 
                          sequence number are now ignored when waiting for an ICMP response.
                          11. Fix a resource leak of a socket when unexpected failures occur in the 
                          CPing::PingUsingWinsock function

 

Copyright (c) 1998 - 2002 by PJ Naughter.  (Web: www.naughter.com, Email: pjna@naughter.com)

All rights reserved.

Copyright / Usage Details:

You are allowed to include the source code in any product (commercial, shareware, freeware or otherwise) 
when your product is released in binary form. You are allowed to modify the source code in any way you want 
except you cannot modify the copyright details at the top of each module. If you want to distribute source 
code with your application, then you are only allowed to distribute versions released by the author. This is 
to maintain a single distribution point for the source code. 


*/


/////////////////////////////////  Includes  //////////////////////////////////
#include "stdafx.h"
#ifndef __AFXPRIV_H__
#pragma message("To avoid this message please put AFXPRIV.H in your PCH")
#include <afxpriv.h>
#endif
#include "ping.h"



/////////////////////////////////  Macros & Statics ///////////////////////////

#ifdef _DEBUG
#define new DEBUG_NEW
#undef THIS_FILE
static char THIS_FILE[] = __FILE__;
#endif


///////////////////////////////// Implementation //////////////////////////////

#ifndef CPING_NO_ICMP

//Internal class which is used to ensure that the ICMP
//function pointers are available 
class _CPING_ICMP
{
public:
//Constructors / Destructors
  _CPING_ICMP();
	~_CPING_ICMP();

protected:
//Member variables
  HINSTANCE         m_hIcmp;         //HINSTANCE of ICMP.DLL
  CPing::LPICMPCREATEFILE  m_pIcmpCreateFile;
  CPing::LPICMPSENDECHO    m_pIcmpSendEcho;
  CPing::LPICMPCLOSEHANDLE m_pIcmpCloseHandle;

	friend class CPing;
};

_CPING_ICMP::_CPING_ICMP()
{
	//Load up the ICMP library
	m_hIcmp = LoadLibrary(_T("ICMP.DLL"));
	if (m_hIcmp)
  {
	  //Retrieve pointers to the functions in the ICMP dll
	  m_pIcmpCreateFile = (CPing::LPICMPCREATEFILE) GetProcAddress(m_hIcmp,"IcmpCreateFile");
	  m_pIcmpSendEcho = (CPing::LPICMPSENDECHO) GetProcAddress(m_hIcmp,"IcmpSendEcho" );
	  m_pIcmpCloseHandle = (CPing::LPICMPCLOSEHANDLE) GetProcAddress(m_hIcmp,"IcmpCloseHandle");

	  if (m_pIcmpCreateFile == NULL || m_pIcmpSendEcho == NULL ||	m_pIcmpCloseHandle == NULL)
    {
		  TRACE(_T("_CPING_ICMP::_CPING_ICMP, Could not find the required functions in the ICMP DLL\n"));

      FreeLibrary(m_hIcmp);
      m_hIcmp = NULL;
    }
  }
  else
		TRACE(_T("_CPING_ICMP::_CPING_ICMP, Could not load up the ICMP DLL\n"));
}

_CPING_ICMP::~_CPING_ICMP()
{
	if (m_hIcmp)
	{
		FreeLibrary(m_hIcmp);
		m_hIcmp = NULL;
  }
}

_CPING_ICMP _cpingData;
#endif //CPING_NO_ICMP

CPingReply::CPingReply()
{
  Address.S_un.S_addr = 0;
  RTT = 0;
  EchoReplyStatus = 0;   
}

#ifndef CPING_NO_WINSOCK2
BOOL CPing::Bind(SOCKET socket, LPCTSTR pszLocalBoundAddress)
{
	//For correct operation of the T2A macro, see MFC Tech Note 59
	USES_CONVERSION;

  //Setup the structure used in sdk "bind" calls
  SOCKADDR_IN sockLocalAddress;
  ZeroMemory(&sockLocalAddress, sizeof(sockLocalAddress));
  sockLocalAddress.sin_family = AF_INET;
  sockLocalAddress.sin_port = htons((u_short)0);

  //Convert to an ASCII string
  LPSTR lpszAsciiLocalAddress = T2A((LPTSTR)pszLocalBoundAddress);
  sockLocalAddress.sin_addr.s_addr = inet_addr(lpszAsciiLocalAddress);

	//If the address is not dotted notation, then do a DNS 
	//lookup of it.
	if (sockLocalAddress.sin_addr.s_addr == INADDR_NONE)
	{
		LPHOSTENT lphost;
		lphost = gethostbyname(lpszAsciiLocalAddress);
		if (lphost != NULL)
			sockLocalAddress.sin_addr.s_addr = ((LPIN_ADDR)lphost->h_addr)->s_addr;
		else
		{
      return FALSE; 
		}
  }

  //Finally call the SDK "bind" function
  return (bind(socket, (sockaddr*) &sockLocalAddress, sizeof(sockLocalAddress)) != SOCKET_ERROR);
}

BOOL CPing::DecodeResponse(LPIP_HEADER pIPHeader, int nBytes, sockaddr_in* from, USHORT nExpectedSequenceNumber, BOOL& bTryAgain)
{
  //By default, attempt retries
  bTryAgain = TRUE;

  //Jump to the ICMP Header
	int nIpHdrlen = pIPHeader->h_len * 4; //Number of 32-bit words*4 = bytes
	LPICMP_HEADER pIcmpHdr = (LPICMP_HEADER) (((char*) pIPHeader) + nIpHdrlen);

  //Not enough data recieved
	if (nBytes < ((int) (nIpHdrlen + sizeof(ICMP_HEADER))))
	{
		TRACE(_T("CPing::DecodeResponse, Received too few bytes in ICMP response packet\n"), inet_ntoa(from->sin_addr));
    SetLastError(ERROR_UNEXP_NET_ERR);
    return FALSE;
	}

  //Check it is the same id as we sent
	if (pIcmpHdr->i_id != (USHORT)GetCurrentProcessId()) 
	{
		TRACE(_T("CPing::DecodeResponse, Received an ICMP response packet for some other process: ID:%d\n"), pIcmpHdr->i_id);
		return FALSE;
	}

  //We will try again if the packet is not the correct sequence number
  bTryAgain = (nExpectedSequenceNumber != pIcmpHdr->i_seq);

  //Check if it is an ICMP_ECHOREPLY packet
	if (pIcmpHdr->i_type != CPING_ICMP_ECHO_REPLY)
	{
		TRACE(_T("CPing::DecodeResponse, Non-echo reply type field in ICMP reponse packet, Value:%d\n"), pIcmpHdr->i_type);
    SetLastError(ERROR_UNEXP_NET_ERR);
		return FALSE;
	}

  return TRUE;
}

//generate an IP checksum based on a given data buffer
USHORT CPing::GenerateIPChecksum(USHORT* pBuffer, int nSize)
{
  unsigned long cksum = 0;

  while (nSize > 1) 
	{
	  cksum += *pBuffer++;
	  nSize -= sizeof(USHORT);
  }
  
  if (nSize) 
	  cksum += *(UCHAR*)pBuffer;

  cksum = (cksum >> 16) + (cksum & 0xffff);
  cksum += (cksum >> 16);
  return (USHORT)(~cksum);
}

//Fill up the ICMP packet with defined values
void CPing::FillIcmpData(LPICMP_HEADER pIcmp, int nPacketSize, USHORT nSequenceNumber)
{
  pIcmp->i_type    = CPING_ICMP_ECHO_REQUEST;
  pIcmp->i_code    = 0;
  pIcmp->i_id      = (USHORT) GetCurrentProcessId();
  pIcmp->i_seq     = nSequenceNumber;
  pIcmp->i_cksum   = 0;
  pIcmp->timestamp = GetTickCount();
 
  //Set up the data which will be sent
  char* pData = ((char*)pIcmp) + sizeof(ICMP_HEADER);
  memset(pData, 'E', nPacketSize - sizeof(ICMP_HEADER));

  //Generate the checksum
  pIcmp->i_cksum = GenerateIPChecksum((USHORT*)pIcmp, nPacketSize);
}

BOOL CPing::PingUsingWinsock(LPCTSTR pszHostName, CPingReply& pr, UCHAR nTTL, DWORD dwTimeout, int nDataSize, UCHAR nTOS, BOOL bDontFragment, LPCTSTR pszLocalBoundAddress, USHORT nSequenceNumber) const
{
	//For correct operation of the T2A macro, see TN059
	USES_CONVERSION;

  //Use the High performace counter to get an accurate RTT
  LARGE_INTEGER Frequency;
	Frequency.QuadPart = 0;
  if (!QueryPerformanceFrequency(&Frequency))
  {
    TRACE(_T("CPing::PingUsingWinsock, Failed to get the high performance counter frequency\n"));
    return FALSE;
  }
  __int64 nTimerFrequency = Frequency.QuadPart;

  //Resolve the address of the host to connect to
  sockaddr_in dest;
  memset(&dest,0,sizeof(dest));
	LPSTR lpszAscii = T2A((LPTSTR) pszHostName);
  unsigned long addr = inet_addr(lpszAscii);
	if (addr == INADDR_NONE)
	{
		//Not a dotted address, then do a lookup of the name
		hostent* hp = gethostbyname(lpszAscii);
		if (hp)
    {
      memcpy(&(dest.sin_addr),hp->h_addr,hp->h_length);
  	  dest.sin_family = hp->h_addrtype;
    }
    else
	  {
		  TRACE(_T("CPing::PingUsingWinsock, Could not resolve the host name %s\n"), pszHostName);
		  return FALSE;
    }
  }
  else
  {
    dest.sin_addr.s_addr = addr;
    dest.sin_family = AF_INET;
  }

  //Create the raw socket
  SOCKET sockRaw = WSASocket(AF_INET, SOCK_RAW, IPPROTO_ICMP, NULL, 0, 0);
  if (sockRaw == INVALID_SOCKET) 
	{
	  TRACE(_T("CPing::PingUsingWinsock, Failed to create a raw socket\n"));
	  return FALSE;
  }

  //Bind to the local address if need be
  if (pszLocalBoundAddress && _tcslen(pszLocalBoundAddress))
  {
    if (!Bind(sockRaw, pszLocalBoundAddress))
    {
  		TRACE(_T("CPing::PingUsingWinsock, Failed to bind to specified address %s\n"), pszLocalBoundAddress);
      closesocket(sockRaw);
      return FALSE;
    }
  }

  //Set the TTL on the socket  
  int nTempTTL = nTTL;
  if (setsockopt(sockRaw, IPPROTO_IP, IP_TTL, (char*) &nTempTTL, sizeof(nTempTTL)) == SOCKET_ERROR)
  {
  	TRACE(_T("CPing::PingUsingWinsock, Failed to set the TTL value on the socket\n"));
    closesocket(sockRaw);
    return FALSE;
  }

  //Set the TOS on the socket  
  int nTempTos = nTOS;
  if (setsockopt(sockRaw, IPPROTO_IP, IP_TOS, (char*) &nTempTos, sizeof(nTempTos)) == SOCKET_ERROR)
  {
  	TRACE(_T("CPing::PingUsingWinsock, Failed to set the Tos value on the socket\n"));
    closesocket(sockRaw);
    return FALSE;
  }

  //Set the Don't Fragment flag on the socket  
  if (bDontFragment)
  {
    if (setsockopt(sockRaw, IPPROTO_IP, IP_DONTFRAGMENT, (char*) &bDontFragment, sizeof(bDontFragment)) == SOCKET_ERROR)
    {
  	  TRACE(_T("CPing::PingUsingWinsock, Failed to set the Don't Fragment value on the socket\n"));
      closesocket(sockRaw);
      return FALSE;
    }
  }
 
  //Allocate the ICMP packet
  int nPacketSize = sizeof(ICMP_HEADER) + min(MAX_CPING_ICMP_DATA_SIZE, nDataSize);
  char* pICMP = new char[nPacketSize];
  FillIcmpData((LPICMP_HEADER) pICMP, nPacketSize, nSequenceNumber);

  //Get the tick count prior to sending the packet
  LARGE_INTEGER TimerTick;
  VERIFY(QueryPerformanceCounter(&TimerTick));
  __int64 nStartTick = TimerTick.QuadPart;

  //Send of the packet
	int nWrote = sendto(sockRaw, pICMP, nPacketSize, 0, (sockaddr*)&dest, sizeof(dest));
	if (nWrote == SOCKET_ERROR)
	{
		TRACE(_T("CPing::PingUsingWinsock, sendto failed\n"));

    delete [] pICMP;

    DWORD dwError = GetLastError();
    closesocket(sockRaw);
    SetLastError(dwError);

    return FALSE;
	}

  //allocate the recv buffer
  LPIP_HEADER pRecvBuf = (LPIP_HEADER) new char[MAX_CPING_ICMP_PACKET_SIZE];
  BOOL bReadable;
  sockaddr_in from;
  int nFromlen = sizeof(from);
  int nRead = 0;

  //Loop around waiting for the correct response
  BOOL bContinueReading = TRUE;
  BOOL bSuccess = FALSE;
  while (bContinueReading)
  {
    //Allow the specified timeout
    if (IsSocketReadible(sockRaw, dwTimeout, bReadable))
    {
      if (bReadable)
      {
        //Receive the response
	      nRead = recvfrom(sockRaw, (char*) pRecvBuf, MAX_CPING_ICMP_PACKET_SIZE, 0, (sockaddr*)&from, &nFromlen);

        //Now check the return response from recvfrom
	      if (nRead != SOCKET_ERROR)
        {
          //Decode the response we got back
         	bSuccess = DecodeResponse(pRecvBuf, nRead, &from, nSequenceNumber, bContinueReading);
        }
      }
      else
      {
		    TRACE(_T("CPing::PingUsingWinsock, timeout occured while awaiting recvfrom\n"));
        closesocket(sockRaw);

        delete [] pICMP;
        delete [] pRecvBuf;
          
        closesocket(sockRaw);

        //set the error to timed out
        SetLastError(WSAETIMEDOUT);

		    return bSuccess;
      }
    }
    else
    {
		  TRACE(_T("CPing::PingUsingWinsock, IsReadible call failed\n"));

      delete [] pICMP;
      delete [] pRecvBuf;

      DWORD dwError = GetLastError();
      closesocket(sockRaw);
      SetLastError(dwError);

		  return FALSE;
    }
  }

  //Get the current tick count
  QueryPerformanceCounter(&TimerTick);

  //Return the values in the CPingReply instance
  if (bSuccess)
  {
    pr.Address = from.sin_addr;
    pr.RTT = (ULONG) ((TimerTick.QuadPart - nStartTick) * 1000 / nTimerFrequency);
  }

  //Free up the memory we allocated
  delete [] pICMP;
  delete [] pRecvBuf;

  //Don't forget to release out socket
  closesocket(sockRaw);

  //return the status
	return bSuccess;
}
#endif //CPING_NO_WINSOCK2

BOOL CPing::IsSocketReadible(SOCKET socket, DWORD dwTimeout, BOOL& bReadible)
{
  timeval timeout;
  timeout.tv_sec =  dwTimeout / 1000;
  timeout.tv_usec = dwTimeout % 1000;
  fd_set fds;
  FD_ZERO(&fds);
  FD_SET(socket, &fds);
  int nStatus = select(0, &fds, NULL, NULL, &timeout);
  if (nStatus == SOCKET_ERROR)
    return FALSE;
  else
  {
    bReadible = !(nStatus == 0);
    return TRUE;
  }
}

#ifndef CPING_NO_ICMP
BOOL CPing::PingUsingICMP(LPCTSTR pszHostName, CPingReply& pr, UCHAR nTTL, DWORD dwTimeout, int nDataSize, UCHAR nTOS, BOOL bDontFragment) const
{
	//For correct operation of the T2A macro, see TN059
	USES_CONVERSION;

	//Make sure ICMP dll is available
	if (_cpingData.m_hIcmp == NULL)
  {
    TRACE(_T("CPing::PingUsingICMP, ICMP dll is not available\n"));
    SetLastError(ERROR_FILE_NOT_FOUND);
	  return FALSE;
  }

	LPSTR lpszAscii = T2A((LPTSTR) pszHostName);
	//Convert from dotted notation if required
	unsigned long	addr = inet_addr(lpszAscii);
	if (addr == INADDR_NONE)
	{
		//Not a dotted address, then do a lookup of the name
		hostent* hp = gethostbyname(lpszAscii);
		if (hp)
			memcpy(&addr, hp->h_addr, hp->h_length);
		else
		{
			TRACE(_T("CPing::PingUsingICMP, Could not resolve the host name %s\n"), pszHostName);
			return FALSE;
		}
	}

  //Create the ICMP handle
  ASSERT(_cpingData.m_pIcmpCreateFile);
	HANDLE hIP = _cpingData.m_pIcmpCreateFile();
	if (hIP == INVALID_HANDLE_VALUE)
	{
		TRACE(_T("CPing::PingUsingICMP, Could not get a valid ICMP handle\n"));
		return FALSE;
	}

  //Set up the option info structure
	IP_OPTION_INFORMATION OptionInfo;
	ZeroMemory(&OptionInfo, sizeof(IP_OPTION_INFORMATION));
	OptionInfo.Ttl = nTTL;
  OptionInfo.Tos = nTOS;
  if (bDontFragment)
    OptionInfo.Flags = IP_FLAG_DF;

  //Set up the data which will be sent
  unsigned char* pBuf = new unsigned char[nDataSize];
  memset(pBuf, 'E', nDataSize);

	//Do the actual Ping
  int nReplySize = sizeof(ICMP_ECHO_REPLY) + nDataSize;
  unsigned char* pReply = new unsigned char[nReplySize];
	ICMP_ECHO_REPLY* pEchoReply = (ICMP_ECHO_REPLY*) pReply;
  ASSERT(_cpingData.m_pIcmpSendEcho);
  DWORD nRecvPackets = _cpingData.m_pIcmpSendEcho(hIP, addr, pBuf, (UCHAR)nDataSize, &OptionInfo, pReply, nReplySize, dwTimeout);

  //Check we got the packet back
  BOOL bSuccess = (nRecvPackets == 1);

  //Check the data we got back is what was sent
  if (bSuccess)
  {
    char* pReplyData = (char*) pEchoReply->Data;
    for (int i=0; i<pEchoReply->DataSize && bSuccess; i++)
      bSuccess = (pReplyData[i] == 'E');

    if (!bSuccess)
    {
      TRACE(_T("CPing::PingUsingICMP, Could not get a valid ICMP response\n"));
      SetLastError(ERROR_UNEXP_NET_ERR);
    }
  }

  //Close the ICMP handle
  ASSERT(_cpingData.m_pIcmpCloseHandle);
	_cpingData.m_pIcmpCloseHandle(hIP);

	if (bSuccess)
	{
    //Ping was successful, copy over the pertinent info
    //into the return structure
		pr.Address.S_un.S_addr = pEchoReply->Address;
	  pr.RTT = pEchoReply->RoundTripTime;
    pr.EchoReplyStatus = pEchoReply->Status;
	}

  //Free up the memory we allocated
  delete [] pBuf;
  delete [] pReply;

  //return the status
	return bSuccess; 
}
#endif //CPING_USE_ICMP
